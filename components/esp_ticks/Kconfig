## components/esp_ticks/Kconfig
```kconfig
menu "Ticks Configuration"

    config TICKS_MAX_TIMERS
        int "Maximum number of concurrent timers"
        default 8
        range 1 32
        help
            Maximum number of software timers that can be created simultaneously.

endmenu
```

## main/Kconfig.projbuild
```kconfig
menu "HMI Configuration"
    config HMI_DOUBLE_FB
        bool "Use double Frame Buffer"
        default n
        help
            Enable this option, driver will allocate two frame buffers.

    config HMI_USE_BOUNCE_BUFFER
        depends on !HMI_DOUBLE_FB
        bool "Use bounce buffer"
        default y
        help
            Enable bounce buffer mode can achieve higher PCLK frequency at the cost of higher CPU consumption.

    config HMI_AVOID_TEAR_EFFECT_WITH_SEM
        depends on !HMI_DOUBLE_FB
        bool "Avoid tearing effect"
        default y
        help
            Enable this option, the HMI will use a pair of semaphores to avoid the tearing effect.
            Note, if the Double Frame Buffer is used, then we can also avoid the tearing effect without the lock.
endmenu
```
